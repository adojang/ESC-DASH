/*
 * File: KeypadBookShelve.cpp
 * Author: Wouter Pieter Willemse
 * Date: December 2, 2023
 * Description: This program opens a doors magnetic lock using a keypad matrix interface and a visual indicator in the form of an OLED Screen.
 * 
Software License Agreement

This Software License Agreement (the "Agreement") is entered into by and between Wouter Pieter Willemse ("Licensor" or "Owner") and any party who obtains a copy of the software (the "Licensee").
1. License Grant
   1.1 License. Licensor grants Licensee a non-exclusive, non-transferable, and lifetime license to use the software (the "Software") subject to the terms and conditions of this Agreement.
   1.2 Restrictions. Licensee shall not, without the prior written consent of Licensor:
       (a) Modify, adapt, alter, translate, or create derivative works from the Software;
       (b) Sell, lease, sublicense, distribute, or otherwise transfer the Software to any third party.

2. Ownership
   2.1 Ownership. Licensor retains all right, title, and interest in and to the Software, including all intellectual property rights.

3. Restrictions on Changes and Sales
   3.1 Changes. Licensee shall not modify, adapt, or alter the Software in any way without the prior written consent of Licensor.
   3.2 Sales. Licensee shall not sell, lease, sublicense, distribute, or otherwise transfer the Software to any third party without the express written consent of Licensor.

4. Term
   4.1 Term. This Agreement is effective until terminated. The lifetime license granted under Section 1.1 shall remain in effect for the lifetime of the Licensee.

5. Termination
   5.1 Termination. This Agreement may be terminated by Licensor immediately upon written notice if Licensee breaches any provision of this Agreement.

6. Governing Law
   6.1 Governing Law. This Agreement shall be governed by and construed in accordance with the laws of [Your Jurisdiction].
IN WITNESS WHEREOF, the parties hereto have executed this Software License Agreement as of the Effective Date.

Wouter Pieter Willemse                      Wendy Skinner
Licensor                                    Licensee
79 Tafelberg Street, Durbanville            Tyger Valley Shopping Centre,Durbanville
 */

#include <Wire.h>
#include <Adafruit_GFX.h>
#include <Adafruit_SSD1306.h>
#include <Keypad.h>
#include <string.h>

#define SCREEN_WIDTH 128 // OLED display width, in pixels
#define SCREEN_HEIGHT 64 // OLED display height, in pixels
#define ROWS  4
#define COLS  3
#define TrigerPin 5
char keyMap[ROWS][COLS] = {
  {'1','2','3'},
  {'4','5','6'},
  {'7','8','9'},
  {'*','0','#'}
};
 
uint8_t rowPins[ROWS] = {14, 27, 26, 25}; // GIOP14, GIOP27, GIOP26, GIOP25
uint8_t colPins[COLS] = {33, 32, 18};     // GIOP33, GIOP32, GIOP18
 
Keypad keypad = Keypad(makeKeymap(keyMap), rowPins, colPins, ROWS, COLS );

int pinpos = 0;
String pin = "112415";
char keyedpin[6] = {};
int cntcorrect = 0;
String printcode = " ";
unsigned long ttimeopen = 0;
// Declaration for an SSD1306 display connected to I2C (SDA, SCL pins)
Adafruit_SSD1306 display(SCREEN_WIDTH, SCREEN_HEIGHT, &Wire, -1);
//Functions
// 'TagDoor', 124x64px
const unsigned char epd_bitmap_TagDoor [] PROGMEM = {
	0x00, 0x00, 0x00, 0x00, 0x00, 0x00, 0x00, 0x00, 0x00, 0x00, 0x00, 0x00, 0x00, 0x00, 0x00, 0x00, 
	0x00, 0x00, 0x00, 0x00, 0x00, 0x00, 0x00, 0x00, 0x00, 0x00, 0x00, 0x00, 0x00, 0x00, 0x00, 0x00, 
	0x00, 0x00, 0x00, 0x00, 0x00, 0x00, 0x00, 0x00, 0x00, 0x00, 0x00, 0x00, 0x00, 0x00, 0x00, 0x00, 
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	0x00, 0x00, 0x00, 0x00, 0x00, 0x00, 0x00, 0x00, 0x00, 0x00, 0x00, 0x00, 0x00, 0x00, 0x00, 0x00
};

// Array of all bitmaps for convenience. (Total bytes used to store images in PROGMEM = 1040)
const int epd_bitmap_allArray_LEN = 1;
const unsigned char* epd_bitmap_allArray[1] = {
	epd_bitmap_TagDoor
};

void checkpin()
{
    cntcorrect = strcmp(pin.c_str(),printcode.c_str());
    Serial.println(pin);
    Serial.println(printcode);
    Serial.println(cntcorrect);
    if(cntcorrect == 0)
    {
    display.clearDisplay();
    display.setCursor(0,0);
    display.setTextSize(3);
    
    display.print("Portal\nOpening");
    display.display();
    ttimeopen = millis();
    delay(1000);
    digitalWrite(TrigerPin,HIGH);
    display.clearDisplay();
    display.setCursor(10,10);
    display.drawBitmap(0,0, epd_bitmap_TagDoor, 128, 64, WHITE);
    display.display();
    display.clearDisplay();
    display.drawBitmap(0,0, epd_bitmap_TagDoor, 128, 64, WHITE);
    display.display();
    }
    if(cntcorrect != 0)
    {
    display.clearDisplay();
    display.setCursor(0,0);
    display.setTextSize(3);
    display.print("Try\nAgain");
    display.display(); 
    }
  
}

void displaypin(char key)
{
    display.clearDisplay();
    display.setCursor(0,0);
    display.setTextSize(3);
    printcode = "";
    pinpos++;
    for(int i = 0; i < pinpos; i++)
    {
    display.print(keyedpin[i]);
    display.display();
    printcode = printcode + keyedpin[i];
    }
    if(pinpos > 5)
    {
        pinpos = 0;
    }
}


void setup() {
  Serial.begin(115200);
  pinMode(TrigerPin,OUTPUT);
  if(!display.begin(SSD1306_SWITCHCAPVCC, 0x3C)) { // Address 0x3D for 128x64
    Serial.println(F("SSD1306 allocation failed"));
    for(;;);
  }
  delay(1000);
  display.clearDisplay();

  display.setTextSize(2);
  display.setTextColor(WHITE);
  display.setCursor(0, 10);
  // Display static text
  display.println("   Who's\n   House\n   Number");
  display.display(); 
}

unsigned long ttimer = millis();

void loop() {

  char key = keypad.getKey();
  if (key) 
  {
    if(key == '#')
    {
        checkpin();
        pinpos = 0;     
    }else
    {
        keyedpin[pinpos] = key;
        displaypin(key);
    }
  }
  if(cntcorrect == 0 && ((millis() - ttimer) > 60000))
  {
    display.clearDisplay();
    display.setCursor(0,0);
    display.setTextSize(2);
    display.println("   Who's\n   House\n   Number");
    display.display(); 
    ttimer = millis();
    pinpos = 0;
  }
  if(millis() - ttimeopen > 500)
  {
    digitalWrite(TrigerPin,LOW);
  }
}

